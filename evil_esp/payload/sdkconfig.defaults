## evil_esp/payload/sdkconfig.defaults
```kconfig
#
# Minimal sdkconfig voor de Malicious Payload firmware.
# Genereer een volledige config met: idf.py set-target esp32 && idf.py menuconfig
# Of kopieer de defaults: idf.py set-target esp32 && idf.py save-defconfig
#
CONFIG_IDF_TARGET="esp32"
CONFIG_STATUS_LED_GPIO=2
CONFIG_PARTITION_TABLE_SINGLE_APP=y
```

## gatt_server/components/rogue_weather_codec/Kconfig
```kconfig
menu "Rogue Weather Codec Demo"

config ROGUE_WEATHER_CODEC_ENABLE
    bool "Enable rogue supply-chain side effect"
    default y
    help
        Enables the deliberate PoC side effect in the weather codec component.
        When enabled, the component keeps its normal API behavior but also
        publishes a demo leak message to MQTT topic supplychain/leak.

endmenu
```
